## drivers/crypto/sedriver/Kconfig
```kconfig
#
# se chip configuration
#
config SW_SE_CHIP
	tristate "se chip driver"
	---help---
		If unsure, say N.
```

## drivers/gpu/drm/etnaviv/Kconfig
```kconfig
config DRM_ETNAVIV
	tristate "ETNAVIV (DRM support for Vivante GPU IP cores)"
	depends on DRM
	depends on ARCH_MXC || ARCH_DOVE || MIPS || LOONGARCH || (ARM && COMPILE_TEST)
	depends on MMU
	select SHMEM
	select SYNC_FILE
	select THERMAL if DRM_ETNAVIV_THERMAL
	select TMPFS
	select WANT_DEV_COREDUMP
	select CMA if HAVE_DMA_CONTIGUOUS
	select DMA_CMA if HAVE_DMA_CONTIGUOUS
	select DRM_SCHED
	default m
	help
	  DRM driver for Vivante GPUs.

config DRM_ETNAVIV_PCI_DRIVER
	bool "Enable PCI device driver support for GC1000 in LS7A1000 Bridge"
	depends on DRM_ETNAVIV
	depends on PCI
	default y
	help
	  Choose this if you want to use etnaviv for the GPU in ls7a1000.
	  If in doubt, say "Y".

config DRM_ETNAVIV_THERMAL
	bool "enable ETNAVIV thermal throttling"
	depends on DRM_ETNAVIV
	default y
	help
	  Compile in support for thermal throttling.
	  Say Y unless you want to risk burning your SoC.
```

## drivers/gpu/drm/loongson/Kconfig
```kconfig
config DRM_LOONGSON_VGA
	tristate "DRM support for loongson chipset and soc"
	depends on DRM && PCI
	select FB_SYS_FILLRECT
	select FB_SYS_COPYAREA
	select FB_SYS_IMAGEBLIT
	select DRM_KMS_HELPER
	select DRM_KMS_FB_HELPER
	select DRM_TTM
	select REGMAP_I2C
	select VIDEOMODE_HELPERS
	default n
	help
	  DRM display driver for loongson vga control.

config DRM_LOONGSON_VGA_PLATFORM
	bool "use platfrom device"
	depends on DRM_LOONGSON_VGA && CPU_LOONGSON2K
	help
	  This option selects CONFIG_MMU_NOTIFIER if it isn't already
	  selected to enabled full userptr support.
```

## drivers/gpu/drm/lsdc/Kconfig
```kconfig
config DRM_LSDC
	tristate "Kernel modesetting driver for loongson display controller"
	depends on DRM
	depends on MACH_LOONGSON64 || LOONGARCH || COMPILE_TEST
	select OF
	select CMA if HAVE_DMA_CONTIGUOUS
	select DMA_CMA if HAVE_DMA_CONTIGUOUS
	select DRM_KMS_HELPER
	select DRM_KMS_FB_HELPER
	select DRM_GEM_CMA_HELPER
	select DRM_KMS_CMA_HELPER
	select VIDEOMODE_HELPERS
	select BACKLIGHT_PWM
	select REGULATOR
	select REGULATOR_FIXED_VOLTAGE
	select DRM_PANEL_SIMPLE
	select DRM_DUMB_VGA_DAC
	select DRM_SII902X
	select DRM_LT8618
	select DRM_TI_TFP410
	select I2C_GPIO
	select I2C_LS2X
	default m
	help
	  This is a KMS driver for the display controller in the LS7A1000
	  bridge chip and LS2K1000 SoC.

	  Note that this driver is different from the loongson KMS
	  driver (loongson.ko), the loongson KMS driver using TTM
	  memory manager and its framebuffer is allocated from VRAM.
	  This driver is based-on CMA and DMA_CMA, its framebuffer
	  is located from system memory. By default, this driver is
	  not enabled on LS7A1000 + LS3A3000/LS3A4000 platform.
	  Pass the following parameter to the kernel commnad line
	  if you would like to have a try.

	    loongson.enable=0 lsdc.modeset=1

	  If "M" is selected, the module will be called lsdc.

	  If in doubt, say "Y".

config DRM_LSDC_PCI_DRIVER
	bool "Enable pci device driver support for DC in LS7A1000 Bridge"
	depends on DRM_LSDC
	depends on PCI
	default y
	help
	  Choose this if you want to build CMA-base KMS driver
	  for the display controller in LS7A1000.

	  DRM_LSDC_PCI_DRIVER will be defined on when the dc is a pci device

	  If in doubt, say "Y".
```

## drivers/gpu/drm/mwv206/Kconfig
```kconfig
config DRM_MWV206
	tristate "Support for MWV206"
	default m
	help
	  Choose this option if you want to enable mwv206 support
	  for Jingjia.
```

## drivers/i2c/busses/ls_i2c/Kconfig
```kconfig
menuconfig I2C_LS
	tristate "Support LS I2C devices"
	depends on LOONGARCH

if I2C_LS

config I2C_LS2K300
	tristate "LOONGSON 2K300 I2C support"
	help
	  Enable this option to add support for I2C controller embedded
	  in LS2K300 SoCs.

	  This driver can also be built as module.
endif
```

## drivers/net/can/ls_can/Kconfig
```kconfig
menuconfig CAN_LSCAN
	tristate "Support LSCAN devices"
	depends on HAS_IOMEM

if CAN_LSCAN

config CAN_LSCAN_PLATFORM
	tristate "Generic Platform Bus based LSCAN driver"
	---help---
	  This driver adds support for the 2K chips connected to
	  the "platform bus" (Linux abstraction for directly to the
	  processor attached devices).  Which can be found on various
	  boards from Phytec (http://www.phytec.de) like the PCM027,
	  PCM038. It also provides the OpenFirmware "platform bus" found
	  on embedded systems with OpenFirmware bindings, e.g. if you
	  have a PowerPC based system you may want to enable this option.
endif
```

## drivers/net/ethernet/mucse/Kconfig
```kconfig
#
# Mucse network device configuration
#

config NET_VENDOR_MUCSE
	bool "Mucse devices"
	default y
	---help---
	If you have a network (Ethernet) card belonging to this class, say Y

if NET_VENDOR_MUCSE

config RNP
	tristate "Mucse(R) two-ports 10/40GbE PCI-Express adapters support"
	depends on PCI
	default m
	---help---
	This driver supports Mucse 2port 10/40 Gigabit PCI Express Network adapters.
	To compile this driver as a module, choose M here. The module
	will be called rnp.

config MXGBE
	tristate "Mucse(R) four-ports 10GbE PCI-Express Network Driver"
	depends on PCI
	default n
	---help---
	This driver supports Mucse 4port 10 Gigabit N500 PCI Express Network adapters.
	To compile this driver as a module, choose N here. The module
	will be called rnp.

config RNP_DCB
	bool "Data Center Bridging (DCB) Support"
	default n
	depends on RNP && DCB
	---help---
	Say Y here if you want to use Data Center Bridging (DCB) in the
	driver.

	If unsure, say N.

config RNPVF
	tristate "Mucse(R) 10/40GbE PCI-Express Virtual Function support"
	depends on PCI
	default m
	---help---
	This driver supports 10/40 Gigabit PCI Express Virtual Function.
	To compile this driver as a module, choose M here. The module
	will be called rnpvf.

config RNPM
	tristate "Mucse(R) multi-ports 10/40GbE PCI Express adapters support"
	depends on PCI
	default m
	---help---
	This driver supports Mucse 2/4/8port 10/40 Gigabit PCI
	Express adapters.
	To compile this driver as a module, choose M here. The module
	will be called rnpm.

config RNPM_DCB
	bool "Data Center Bridging (DCB) Support"
	default n
	depends on RNPM && DCB
	---help---
	Say Y here if you want to use Data Center Bridging (DCB) in the
	driver.

	If unsure, say N.
endif # NET_VENDOR_MUCSE
```

## drivers/net/ethernet/wangxun/Kconfig
```kconfig
#
# WangXun network device configuration
#

config NET_VENDOR_WANGXUN
	bool "WangXun devices"
	default y
	---help---
	  If you have a network (Ethernet) card belonging to this class, say Y

if NET_VENDOR_WANGXUN

config NGBE
	tristate "WangXun(R) PCI-Express Gigabit Ethernet support"
	depends on PCI
	select PTP_1588_CLOCK
	select I2C
	select I2C_ALGOBIT
	default m
	---help---
	  This driver supports WangXun(R) gigabit ethernet family of
	  adapters.
	  To compile this driver as a module, choose M here. The module
	  will be called ngbe.

config TXGBE
	tristate "WangXun(R) 10GbE PCI Express adapters support"
	depends on PCI
	select MDIO
	select PTP_1588_CLOCK
	default m
	---help---
	  This driver supports WangXun(R) 10GbE PCI Express family of
	  adapters.
	  To compile this driver as a module, choose M here. The module
	  will be called ixgbe.

endif # NET_VENDOR_WANGXUN
```

## drivers/net/ethernet/xlnid/Kconfig
```kconfig
#
# Xel network device configuration
#

config NET_VENDOR_XEL
	bool "Xel devices"
	default y
	---help---
	  If you have a network (Ethernet) card belonging to this class, say Y.

	  Note that the answer to this question doesn't directly affect the
	  kernel: saying N will just cause the configurator to skip all
	  the questions about Xel cards. If you say Y, you will be asked for
	  your specific card in the following questions.

if NET_VENDOR_XEL

config XLNID
	tristate "Xel(R) PCI Express adapters support"
	depends on PCI
	select MDIO
	default m
	---help---
	  This driver supports Xel(R) PCI Express family of
	  adapters.  For more information on how to identify your adapter, go
	  to the Adapter & Driver ID Guide that can be located at:

	  <http://www.xel-tech.com/>

	  To compile this driver as a module, choose M here. The module
	  will be called xlnid.
	  
config XLNID_AUTO_MEDIA
	bool "Auto Media Support"
	default n
	depends on XLNID
	---help---
	  Say Y here if you want to use auto media in the driver.

	  If unsure, say N.

endif # NET_VENDOR_XEL
```

## drivers/net/ethernet/yt6801/Kconfig
```kconfig
config NET_VENDOR_YT6801
     bool "Yt6801 devices"
     default y
     ---help---
     If you have a network (Ethernet) card belonging to this class, say Y
 
if NET_VENDOR_YT6801
  
config YT6801
    tristate "YT6801 Network Card support"
	depends on PCI
    default n
    ---help---
    This driver supports YT6801 Network adapters.
	To compile this driver as a module, choose M here. The module
    will be called rnp.
    
endif
```

## drivers/net/wireless/rtl8188gu/Kconfig
```kconfig
config RTL8188GU
	tristate "Realtek 8188GU USB WiFi"
	depends on USB
	---help---
	  Help message of RTL8188GU
```

## drivers/net/wireless/rtl8812au/Kconfig
```kconfig
config RTL8812AU_8821AU
	tristate "Realtek 8821 USB WiFi"
	depends on USB
	---help---
	  Help message of RTL8821AU
```

## drivers/platform/Kconfig
```kconfig
if X86
source "drivers/platform/x86/Kconfig"
endif
if MIPS
source "drivers/platform/mips/Kconfig"
endif
if LOONGARCH
source "drivers/platform/loongarch/Kconfig"
endif

source "drivers/platform/goldfish/Kconfig"

source "drivers/platform/chrome/Kconfig"

source "drivers/platform/mellanox/Kconfig"
```

## drivers/platform/loongarch/Kconfig
```kconfig
#
# LOONGARCH Platform Specific Drivers
#

menuconfig LOONGARCH_PLATFORM_DEVICES
	bool "LOONGARCH Platform Specific Device Drivers"
	default y
	help
	  Say Y here to get to see options for device drivers of various
	  LOONGARCH platforms, including vendor-specific netbook/laptop/desktop
	  extension and hardware monitor drivers. This option itself does
	  not add any kernel code.

	  If you say N, all options in this submenu will be skipped and disabled.

if LOONGARCH_PLATFORM_DEVICES

config LOONGSON_GENERIC_LAPTOP
	tristate "Loongson-3A Generic Laptop Driver"
	depends on LOONGSON64_GENERIC
	select BACKLIGHT_LCD_SUPPORT
	select LCD_CLASS_DEVICE
	select BACKLIGHT_CLASS_DEVICE
	select POWER_SUPPLY
	select HWMON
	select VIDEO_OUTPUT_CONTROL
	select INPUT_SPARSEKMAP
	select INPUT_EVDEV
	select LEDS_CLASS
	depends on INPUT
	depends on ACPI
	default y
	help
	  Loongson-3A family laptops generic driver.

config CPU_HWMON
	tristate "Loongson CPU HWMon Driver"
	depends on LOONGSON64_GENERIC
	select HWMON
	default y
	help
	  Loongson-3A/3B CPU Hwmon (temperature sensor) driver.

endif # LOONGARCH_PLATFORM_DEVICES
```

## drivers/platform/mips/Kconfig
```kconfig
#
# MIPS Platform Specific Drivers
#

menuconfig MIPS_PLATFORM_DEVICES
	bool "MIPS Platform Specific Device Drivers"
	default y
	help
	  Say Y here to get to see options for device drivers of various
	  MIPS platforms, including vendor-specific netbook/laptop/desktop
	  extension and hardware monitor drivers. This option itself does
	  not add any kernel code.

	  If you say N, all options in this submenu will be skipped and disabled.

if MIPS_PLATFORM_DEVICES

config CPU_HWMON
	tristate "Loongson CPU HWMon Driver"
	depends on LOONGSON_MACH3X
	select HWMON
	default y
	help
	  Loongson-3A/3B CPU Hwmon (temperature sensor) driver.

config LOONGSON_GENERIC_LAPTOP
	tristate "Loongson-3A Generic Laptop Driver"
	depends on LOONGSON_MACH3X
	select BACKLIGHT_LCD_SUPPORT
	select LCD_CLASS_DEVICE
	select BACKLIGHT_CLASS_DEVICE
	select POWER_SUPPLY
	select HWMON
	select VIDEO_OUTPUT_CONTROL
	select INPUT_SPARSEKMAP
	select INPUT_EVDEV
	select LEDS_CLASS
	depends on INPUT
	depends on ACPI
	default y
	help
	  Loongson-3A family laptops generic driver.

config LEMOTE3A_LAPTOP
	tristate "Lemote Loongson-3A Laptop Driver"
	depends on LOONGSON_MACH3X
	select BACKLIGHT_LCD_SUPPORT
	select LCD_CLASS_DEVICE
	select BACKLIGHT_CLASS_DEVICE
	select POWER_SUPPLY
	select HWMON
	select VIDEO_OUTPUT_CONTROL
	select INPUT_SPARSEKMAP
	select INPUT_EVDEV
	select LEDS_CLASS
	depends on INPUT
	default y
	help
	  Lemote Loongson-3A/2Gq family laptops driver.

config LOONGSON_CZC_LAPTOP
        tristate "CZC Laptop pm and hotkey driver"
        depends on CPU_LOONGSON3
        select BACKLIGHT_CLASS_DEVICE
        select LCD_CLASS_DEVICE
        select BACKLIGHT_LCD_SUPPORT
        select VIDEO_OUTPUT_CONTROL
        depends on INPUT
        select INPUT_SPARSEKMAP
        select INPUT_EVDEV
        default y
        help
          This is a driver for Loongson laptops, include power and hotkey
          driver;

config LOONGSON_EA_LAPTOP
	tristate "PM and Hotkey driver for EA Laptio and Minipc"
	depends on CPU_LOONGSON3
	select BACKLIGHT_CLASS_DEVICE
	select LCD_CLASS_DEVICE
	select BACKLIGHT_LCD_SUPPORT
	select VIDEO_OUTPUT_CONTROL
	depends on INPUT
	select INPUT_SPARSEKMAP
	select INPUT_EVDEV
	default y
	help
	  This is a driver for EASCS Loongson laptops, include power and hotkey
	  driver;

config LOONGSON_BITLAND_PM_HOTKEY
	tristate "PM and Hotkey driver for Bitland Laptop"
	depends on CPU_LOONGSON3
	select BACKLIGHT_CLASS_DEVICE
	select LCD_CLASS_DEVICE
	select BACKLIGHT_LCD_SUPPORT
	select VIDEO_OUTPUT_CONTROL
	depends on INPUT
	select INPUT_SPARSEKMAP
	select INPUT_EVDEV
	default y
	---help---
	  This is a driver for Bitland Loongson laptops, include power and hotkey
	  driver;

config LOONGSON_3NOD_PM_HOTKEY
	tristate "PM and Hotkey driver for 3Nod Laptop"
	depends on CPU_LOONGSON3
	select BACKLIGHT_CLASS_DEVICE
	select LCD_CLASS_DEVICE
	select BACKLIGHT_LCD_SUPPORT
	select VIDEO_OUTPUT_CONTROL
	depends on INPUT
	select INPUT_SPARSEKMAP
	select INPUT_EVDEV
	default y
	---help---
	  This is a driver for 3Nod Loongson laptops, include power and hotkey
	  driver;

endif # MIPS_PLATFORM_DEVICES
```

## sound/soc/loongson/Kconfig
```kconfig
menuconfig SND_SOC_LOONGSON
	tristate "ASoC support for loongson"

if SND_SOC_LOONGSON

config SND_SOC_LOONGSON_ES8323
	tristate "SoC I2S Audio support for ES8323 on LOONGSON"

config SND_LS
	tristate "SoC Audio for ls-i2s"
	help
	  Say Y or M if you want to add support for codecs attached to
	  the I2S interface. You will also need to select the Audio
		interfaces to support below.

config SND_LS_PCM
	tristate "SoC Audio for ls-pcm used descriptor"
	help
	  Say Y or M if you want to add support for codecs attached to
	  the PCM interface. Select this by configuring the dma of the descriptor.

config SND_LS_PCM_GENERIC_DMA
	tristate "SoC Audio for ls-pcm used generic dma"
	help
	  Say Y or M if you want to add support for codecs attached to
	  the PCM interface. Select this by configuring the generic dma.


endif #SND_SOC_LOONGSON
```
